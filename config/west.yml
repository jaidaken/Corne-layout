## config/west.yml
```yaml
manifest:
  remotes:
    - name: zmkfirmware
      url-base: https://github.com/zmkfirmware
    - name: mctechnology17
      url-base: https://github.com/mctechnology17
    - name: jaidaken
      url-base: https://github.com/jaidaken
  projects:
    - name: zmk
      remote: zmkfirmware
      revision: v0.3.0
      import: app/west.yml
    - name: zmk-nice-oled
      remote: mctechnology17
      revision: main
    - name: keyb-viewer
      remote: jaidaken
      revision: main
  self:
    path: config
```
